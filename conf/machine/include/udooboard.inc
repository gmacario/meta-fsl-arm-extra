## conf/machine/include/udooboard.inc
```bitbake
# Common settings for wandboard boards

include conf/machine/include/imx-base.inc
include conf/machine/include/tune-cortexa9.inc

PREFERRED_PROVIDER_virtual/kernel ?= "linux-udooboard"
PREFERRED_VERSION_linux-udooboard ?= "3.14.28"

PREFERRED_PROVIDER_u-boot ?= "u-boot-udooboard"

SERIAL_CONSOLE = "115200 ttymxc0"

MACHINE_FEATURES += " "

KERNEL_IMAGETYPE = "zImage"
```

## conf/machine/udooneo.conf
```bitbake
#@TYPE: Machine
#@NAME: UDOO Neo i.MX6 SoloX
#@SOC: i.MX6S
#@DESCRIPTION: Machine configuration for i.MX6 UDOO Neo SoloX
#@MAINTAINER: Christian Ege <ch@ege.io>

include conf/machine/include/imx-base.inc
include conf/machine/include/tune-cortexa9.inc

SOC_FAMILY = "mx6:mx6sx"


PREFERRED_PROVIDER_virtual/kernel ?= "linux-udooboard"
PREFERRED_VERSION_linux-udooboard ?= "3.14.28"
PREFERRED_PROVIDER_u-boot ?= "u-boot-udooboard"
KERNEL_IMAGETYPE = "zImage"

KERNEL_DEVICETREE ?= "imx6sx-udoo-neo-hdmi-m4.dtb \
                     imx6sx-udoo-neo-hdmi.dtb \
                     imx6sx-udoo-neo-lvds15.dtb \
                     imx6sx-udoo-neo-lvds7.dtb \
                     imx6sx-udoo-neo-m4.dtb \
                     imx6sx-udoo-neo.dtb \
"

UBOOT_MACHINE ?= "udoo_neo_config"
UBOOT_DEFAULT_DEVICETREE ?= "imx6sx-udoo-neo-hdmi-m4.dtb"

MACHINE_FEATURES += " usbgadget bluetooth wifi"
MACHINE_EXTRA_RRECOMMENDS += "linux-firmware-wl18xx"

SERIAL_CONSOLES ?= "115200;ttymxc0 115200;ttyGS0"
KERNEL_MODULE_AUTOLOAD += " g_serial"
```

## conf/machine/udooquad.conf
```bitbake
#@TYPE: Machine
#@NAME: UDOO i.MX6 Quad
#@SOC: i.MX6S
#@DESCRIPTION: Machine configuration for i.MX6 UDOO neo SoloX
#@MAINTAINER: Christian Ege <ch@ege.io>

include include/udooboard.inc

SOC_FAMILY = "mx6:mx6q"

UBOOT_MACHINE = "udoo_quad_config"

KERNEL_DEVICETREE = "imx6q-udoo.dtb"
```
